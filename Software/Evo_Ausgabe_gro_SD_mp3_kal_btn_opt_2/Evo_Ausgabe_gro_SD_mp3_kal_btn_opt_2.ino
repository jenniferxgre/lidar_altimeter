#include <Wire.h>
#include <LiquidCrystal_I2C.h>
#include <SPI.h>
#include <SD.h>
#include <TimeLib.h>
#include <SoftwareSerial.h>
#include <DFRobotDFPlayerMini.h>

#define SENSOR_ADDR 0x31  // Sensoradresse definieren

LiquidCrystal_I2C lcd(0x27, 16, 2); // construct LCD object

File myFile;      // Datei erstellen
String filename;
uint8_t i=0;

SoftwareSerial mySoftwareSerial(5,6); // RX, TX
DFRobotDFPlayerMini myDFPlayer;

// Custom character definitions
const char custom[][8] PROGMEM = {                        
      { 0x1F, 0x1F, 0x1F, 0x00, 0x00, 0x00, 0x00, 0x00 }, // char 1 
      { 0x18, 0x1C, 0x1E, 0x1F, 0x1F, 0x1F, 0x1F, 0x1F }, // char 2 
      { 0x1F, 0x1F, 0x1F, 0x1F, 0x1F, 0x0F, 0x07, 0x03 }, // char 3 
      { 0x00, 0x00, 0x00, 0x00, 0x00, 0x1F, 0x1F, 0x1F }, // char 4 
      { 0x1F, 0x1F, 0x1F, 0x1F, 0x1F, 0x1E, 0x1C, 0x18 }, // char 5 
      { 0x1F, 0x1F, 0x1F, 0x00, 0x00, 0x00, 0x1F, 0x1F }, // char 6 
      { 0x1F, 0x00, 0x00, 0x00, 0x00, 0x1F, 0x1F, 0x1F }, // char 7 
      { 0x03, 0x07, 0x0F, 0x1F, 0x1F, 0x1F, 0x1F, 0x1F }  // char 8 
};

// BIG FONT Character Set
// - Each character coded as 1-4 byte sets {top_row(0), top_row(1)... bot_row(0), bot_row(0)..."}
// - number of bytes terminated with 0x00; Character is made from [number_of_bytes/2] wide, 2 high
// - codes are: 0x01-0x08 => custom characters, 0x20 => space, 0xFF => black square

const char bigChars[][8] PROGMEM = {
      { 0x20, 0x20, 0x00, 0x00, 0x00, 0x00, 0x00, 0x00 }, // Space
      { 0xFF, 0x07, 0x00, 0x00, 0x00, 0x00, 0x00, 0x00 }, // !
      { 0x05, 0x05, 0x20, 0x20, 0x00, 0x00, 0x00, 0x00 }, // "
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      { 0x20, 0x20, 0x20, 0x04, 0x04, 0x04, 0x00, 0x00 }  // _
};
byte col,row,nb=0,bc=0;                                   // general
byte bb[8];                                               // byte buffer for reading from PROGMEM



// Create a Cyclic Redundancy Checks table used in the "crc8" function
static const uint8_t crc_table[] = {
    0x00, 0x07, 0x0e, 0x09, 0x1c, 0x1b, 0x12, 0x15, 0x38, 0x3f, 0x36, 0x31,
    0x24, 0x23, 0x2a, 0x2d, 0x70, 0x77, 0x7e, 0x79, 0x6c, 0x6b, 0x62, 0x65,
    0x48, 0x4f, 0x46, 0x41, 0x54, 0x53, 0x5a, 0x5d, 0xe0, 0xe7, 0xee, 0xe9,
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    0xfa, 0xfd, 0xf4, 0xf3
};

uint8_t buf[3];           // The variable "buf[3]" will contain the frame sent by the TeraRanger

uint16_t offset;


// ********************************************************************************** //
//                                      SETUP
// ********************************************************************************** //

void setup() {

  Wire.begin();           // Join I2C bus as master
  
  // LCD initialisieren
  lcd.begin();
  for (nb=0; nb<8; nb++ ) {                     // create 8 custom characters
    for (bc=0; bc<8; bc++) bb[bc]= pgm_read_byte( &custom[nb][bc] );
    lcd.createChar ( nb+1, bb );
  }
  lcd.clear();
  //lcd.setCursor(0,0);
  lcd.backlight();

  // SD initialisieren
  while (!SD.begin(10)) {
    writeBigString("SD", 0, 0);
    delay(1500);
    lcd.clear();
    //delay(50);
  }

  //Startbildschirm
  writeBigString("LOAD", 0, 0);

  // Datei mit richtigem Namen erstellen und öffnen
    for (uint8_t i = 0; i <= 1000; i++){
    String i_str = String(i);
    if (!SD.exists(String("data_" + i_str + ".csv"))){
      filename = String("data_" + i_str + ".csv");
      break;
    }
  }
  
  myFile = SD.open(filename, FILE_WRITE);
  if(myFile){
    myFile.println("TIMESTAMP;ENTFERNUNG");
    myFile.close();
  }


  // MP3 Modul initialisieren
  mySoftwareSerial.begin(9600);
  myDFPlayer.begin(mySoftwareSerial);
  myDFPlayer.volume(10);
  myDFPlayer.playMp3Folder(7);
  //delay(1000);

  //


  // Kalibrieren 
 pinMode(2, INPUT_PULLUP);
  if (digitalRead(2) == LOW) {
    offset = messen();    
    if (SD.exists("offset.txt")) {
      SD.remove("offset.txt");
    }
    
    myFile = SD.open("offset.txt", FILE_WRITE);
    if(myFile){

      myFile.write(buf[0]);
      myFile.write(buf[1]);

      myFile.close();
    }
  }
  else {
    myFile = SD.open("offset.txt", FILE_READ);

    if(myFile.available() > 0){
      offset = ((uint16_t) myFile.read() << 8) | (uint16_t) myFile.read();
      myFile.close();
    }
    else {
      offset = 0;
    }

  }

  
  lcd.clear();
  
}


// ********************************************************************************** //
//                                      MAIN LOOP
// ********************************************************************************** //

void loop() {
  
  // VARIABLES: -----------------

  uint16_t distance = 0;    // The variable "distance" will contain the distance value in millimeter
  float distance_m = 0;
  char distance_c[5];
  uint16_t distBuf = 0;

  //-----------------------------
  if (messen()<=offset)
  {
    distance = 0.0;
  }
  else
  {
    distance = messen()-offset;
  }


  distance_m = (float) distance / 1000.0;
  dtostrf(distance_m, 5, 1, distance_c);


  if((distance_m<=10.0) && (distance_m>0.4)){
    
    // in Datei speichern
    myFile = SD.open(filename, FILE_WRITE);
    if(myFile){
      unsigned long t = millis(); // Timestamp bekommen
      myFile.print(t);
      myFile.print(";");
      myFile.println(distance);
      myFile.close();
    }
       
    if(i<9){

      i++;

    }
    else{

      i=0;
      // Ausagabe auf Display
      lcd.setCursor(0,0);
      lcd.clear();
      writeBigString(distance_c, 0, 0);
      writeBigChar('M', 12, 0);

      // Audio-Callout MP3-Modul
      if ((distBuf-distance > 50) && (distBuf > distance)){
        
        callout(distance, mySoftwareSerial);
        
        distBuf = distance;
      }

    }

    delay(100);       // Pause
  
  }

  else{

    // Ausagabe auf Display
    lcd.setCursor(0,0);
    lcd.clear();
    writeBigString(distance_c, 0, 0);
    writeBigChar('M', 12, 0);

    // in Datei speichern
    myFile = SD.open(filename, FILE_WRITE);
    if(myFile){
      unsigned long t = millis(); // Timestamp bekommen
      myFile.print(t);
      myFile.print(";");
      myFile.println(distance);
      myFile.close();
    }
    
    // Audio-Callout MP3-Modul
    if ((distBuf-distance > 50) && (distBuf > distance)){
      
      callout(distance, mySoftwareSerial);
      
      distBuf = distance;
    }

    delay(1000);       // Pause

  }


}

// ********************************************************************************** //
//                                      SUBROUTINES
// ********************************************************************************** //


uint8_t crc8(uint8_t *p, uint8_t len) {
  uint8_t i;
  uint8_t crc = 0x0;
  while (len--) {
    i = (crc ^ *p++) & 0xFF;
    crc = (crc_table[i] ^ (crc << 8)) & 0xFF;
  }
  return crc & 0xFF;
}

// writeBigChar: writes big character 'ch' to column x, row y; returns number of columns used by 'ch'
int writeBigChar(char ch, byte x, byte y) {
  if (ch < ' ' || ch > '_') return 0;               // If outside table range, do nothing
  nb=0;                                             // character byte counter 
  for (bc=0; bc<8; bc++) {                        
    bb[bc] = pgm_read_byte( &bigChars[ch-' '][bc] );  // read 8 bytes from PROGMEM
    if(bb[bc] != 0) nb++;
  }  
 
  bc=0;
  for (row = y; row < y+2; row++) {
    for (col = x; col < x+nb/2; col++ ) {
      lcd.setCursor(col, row);                      // move to position
      lcd.write(bb[bc++]);                          // write byte and increment to next
    }

  }
  return nb/2-1;                                      // returns number of columns used by char
}

// writeBigString: writes out each letter of string
void writeBigString(char *str, byte x, byte y) {
  char c;
  while ((c = *str++))
  x += writeBigChar(c, x, y) + 1;
}


// Funktion zum Entfernung messen

uint16_t messen() {

  uint16_t dist;
  uint8_t CRC = 0;          // The variable "CRC" will contain the checksum to compare at TeraRanger's one
  
  Wire.beginTransmission(SENSOR_ADDR);      // Transmit to TR1 (THIS IS THE I2C BASE ADDRESS, CHANGE HERE IN CASE IT IS DIFFERENT)
    Wire.write(0x00);                         // Sends trigger byte
    Wire.endTransmission();                   // Stop transmitting
  
    delay(0.5);                               // Delay in between reads
  
    Wire.requestFrom(SENSOR_ADDR, 3);          // Read back three bytes from TR1 (THIS IS THE I2C BASE ADDRESS, CHANGE HERE IN CASE IT IS DIFFERENT)
    buf[0] = Wire.read();               // First byte of distance
    buf[1] = Wire.read();               // Second byte of distance
    buf[2] = Wire.read();               // Byte of checksum
    
    CRC = crc8(buf, 2);                 // Save the "return" checksum in variable "CRC" to compare with the one sent by the TeraRanger
  
    
    if (CRC == buf[2]) {                // If the function crc8 return the same checksum than the TeraRanger, then:
      dist = (buf[0]<<8) + buf[1];      // Calculate distance in mm
     
    }
    else {                                                   
      dist = 0;
                              
    }                                                         
  
    return dist;
}

// MP3 Ausgabe Höhen-Callout

void callout(uint16_t xdistance, SoftwareSerial xmySoftwareSerial) {
  
  uint8_t announced = 0;

    
  if (myDFPlayer.begin(mySoftwareSerial)){
    
    if ((announced != 1) && xdistance < 52000 && xdistance > 48000){
      myDFPlayer.playMp3Folder(1);
      announced = 1;
    }
    else if ((announced != 2) && xdistance < 42000 && xdistance > 38000){
      myDFPlayer.playMp3Folder(2);
      announced = 2;
    }
    else if ((announced != 3) && xdistance < 32000 && xdistance > 28000){
      myDFPlayer.playMp3Folder(3);
      announced = 3;
    }
    else if ((announced != 4) && xdistance < 22000 && xdistance > 18000){
      myDFPlayer.playMp3Folder(4);
      announced = 4;
    }
    else if ((announced != 5) && xdistance < 12000 && xdistance > 9000){
      myDFPlayer.playMp3Folder(5);
      announced = 5;
    }
    else if ((announced != 6) && xdistance < 6000 && xdistance > 4000){
      myDFPlayer.playMp3Folder(6);
      announced = 6;
    }
  
  }
  
}
